## CMakeLists.txt
```
# SPDX-License-Identifier: Apache-2.0

cmake_minimum_required(VERSION 3.20.0)

list(APPEND BOARD_ROOT ${CMAKE_CURRENT_SOURCE_DIR})
set(BOARD "mcxn947_protocard/mcxn947/cpu0")

find_package(Zephyr REQUIRED HINTS $ENV{ZEPHYR_BASE})
project(oresat_mcxn947_demo)

target_sources(app PRIVATE src/main.c)

# Compile in various demos depending on Kconfig values.
target_sources_ifdef(CONFIG_BLINK_DEMO      app PRIVATE src/blink.c)
target_sources_ifdef(CONFIG_I2C_SENSOR_DEMO app PRIVATE src/i2c_sensor.c)
target_sources_ifdef(CONFIG_DAC_DEMO        app PRIVATE src/dac.c)
target_sources_ifdef(CONFIG_ADC_DEMO        app PRIVATE src/adc.c)
```

## Kconfig
```
# Copyright (c) 2024 Centro de Inovacao EDGE.
# SPDX-License-Identifier: Apache-2.0

menu "Oresat MCXN947 Breakout Demo"

config BLINK_DEMO
    bool "Blink an LED"
    default y
    help
      Enable the thread which blinks an LED.

config I2C_SENSOR_DEMO
    bool "Enable monitoring an I2C sensor"
    default y
    help
      Enable reading from a Bosch Sensortec BME280.

config DAC_DEMO
    bool "Enable generation of a sawtooth pattern."
    default y
    help
       Enable a slowly repeating sawtooth from 0 to 3.3v.

config ADC_DEMO
    bool "Enable monitoring one or more ADC channels."
    default y
    help
      Outputs the data scaled to mV.

if ADC_DEMO

config SEQUENCE_SAMPLES
	int "Number of samples to be made on the sequence for each channel."
	default 5

config SEQUENCE_RESOLUTION
	int "Set the resolution of the sequence readings."
	default 12

config SEQUENCE_32BITS_REGISTERS
	bool "ADC data sequences are on 32bits"
	default n

endif

endmenu

source "Kconfig.zephyr"
```

## prj.conf
```kconfig
CONFIG_GPIO=y
CONFIG_CONSOLE=y
CONFIG_UART_CONSOLE=y
CONFIG_STDOUT_CONSOLE=y

CONFIG_I2C=y
CONFIG_SENSOR=y
CONFIG_SENSOR_ASYNC_API=y

CONFIG_DAC=y

CONFIG_ADC=y
CONFIG_SEQUENCE_SAMPLES=8

CONFIG_LOG=y
CONFIG_LOG_MODE_DEFERRED=y
CONFIG_LOG_BUFFER_SIZE=20480
CONFIG_LOG_PRINTK=y

CONFIG_LOG_DEFAULT_LEVEL=4
CONFIG_SENSOR_LOG_LEVEL_DBG=y
CONFIG_KERNEL_LOG_LEVEL_INF=y
CONFIG_ADC_LOG_LEVEL_INF=y
CONFIG_DAC_LOG_LEVEL_DBG=y

CONFIG_HEAP_MEM_POOL_SIZE=256
CONFIG_ASSERT=y
```

## src/main.c
```c
/**
 * main.c
 *
 * Simple main that only logs a bootup message. The remainder
 * of the demos are implemented as independent threads
 * in blink.c, dac.c, i2c_sensor.c, and adc.c.
 *
 * These can be disabled at compile time by adding:
 *   CONFIG_BLINK_DEMO=n
 * for example, to prj.conf. See Kconfig for the options or run
 * west build -t menuconfig for an interacive configuration
 * editor.
 */
#include <stdio.h>
#include <zephyr/kernel.h>
#include <zephyr/sys/printk.h> 
#include <zephyr/sys/__assert.h>

#include <zephyr/logging/log.h>

LOG_MODULE_REGISTER(oresat_mcxn947_demo, LOG_LEVEL_DBG);

int main(void)
{
	printk("\n");
	LOG_INF("Oresat MCXN947 Breakout Board Demo\n");
	return 0;
}
```

## src/adc.c
```c
/**
 * adc.c
 *
 * Original code came from zephyr/samples/driver/adc_sequence.
 *
 * Modified slightly to run as a thread and use logging.
 */

#include <stdio.h>
#include <zephyr/kernel.h>
#include <zephyr/sys/printk.h> 
#include <zephyr/sys/__assert.h>

#include <zephyr/device.h>
#include <zephyr/devicetree.h>
#include <zephyr/dsp/print_format.h>
#include <zephyr/drivers/adc.h>
#include <zephyr/logging/log.h>

LOG_MODULE_REGISTER(oresat_adc_demo, LOG_LEVEL_DBG);

/* size of stack area used by each thread */
#define STACKSIZE 1024

/* scheduling priority used by each thread */
#define PRIORITY 7

/* 1000 msec = 1 sec */
#define ADC_SLEEP_TIME_MS 100 /* Use 5 to generate more data to graph samples that follow the DAC output */

/* ADC node from the devicetree. */
#define ADC_NODE DT_ALIAS(adc0)

/* Auxiliary macro to obtain channel vref, if available. */
#define CHANNEL_VREF(node_id) DT_PROP_OR(node_id, zephyr_vref_mv, 0)

/* Data of ADC device specified in devicetree. */
static const struct device *adc = DEVICE_DT_GET(ADC_NODE);

/* Data array of ADC channels for the specified ADC. */
static const struct adc_channel_cfg channel_cfgs[] = {
	DT_FOREACH_CHILD_SEP(ADC_NODE, ADC_CHANNEL_CFG_DT, (,))};

/* Data array of ADC channel voltage references. */
static uint32_t vrefs_mv[] = {DT_FOREACH_CHILD_SEP(ADC_NODE, CHANNEL_VREF, (,))};

/* Get the number of channels defined on the DTS. */
#define CHANNEL_COUNT ARRAY_SIZE(channel_cfgs)

static int handle_adc(void)
{
	int err;
#ifdef CONFIG_SEQUENCE_32BITS_REGISTERS
	uint32_t channel_reading[CONFIG_SEQUENCE_SAMPLES][CHANNEL_COUNT];
#else
	uint16_t channel_reading[CONFIG_SEQUENCE_SAMPLES][CHANNEL_COUNT];
#endif

	/* Options for the sequence sampling. */
	const struct adc_sequence_options options = {
		.extra_samplings = CONFIG_SEQUENCE_SAMPLES - 1,
		.interval_us = 0,
	};

	/* Configure the sampling sequence to be made. */
	struct adc_sequence sequence = {
		.buffer = channel_reading,
		/* buffer size in bytes, not number of samples */
		.buffer_size = sizeof(channel_reading),
		.resolution = CONFIG_SEQUENCE_RESOLUTION,
		.options = &options,
	};

	LOG_INF("Starting ADC demo");

	if (!device_is_ready(adc)) {
		LOG_ERR("ADC controller device %s not ready", adc->name);
		return 0;
	}

	LOG_INF("Channels: %d, sequence samples: %d, resolution: %d",
		   CHANNEL_COUNT, CONFIG_SEQUENCE_SAMPLES, CONFIG_SEQUENCE_RESOLUTION);

	/* Configure channels individually prior to sampling. */
	for (size_t i = 0U; i < CHANNEL_COUNT; i++) {
		sequence.channels |= BIT(channel_cfgs[i].channel_id);
		err = adc_channel_setup(adc, &channel_cfgs[i]);
		if (err < 0) {
			LOG_ERR("Could not setup channel #%d (%d)\n", i, err);
			return 0;
		}
		if ((vrefs_mv[i] == 0) && (channel_cfgs[i].reference == ADC_REF_INTERNAL)) {
			vrefs_mv[i] = adc_ref_internal(adc);
		}
		LOG_INF("Channel: %u, vref_mv: %u, gain: %u, acq time: %u, diff: %u, inp_pos: %u, inp_neg: %u",
			   channel_cfgs[i].channel_id, vrefs_mv[i], channel_cfgs[i].gain, channel_cfgs[i].acquisition_time,
			   channel_cfgs[i].differential, channel_cfgs[i].input_positive, channel_cfgs[i].input_negative);
	}

	while (1) {
		k_msleep(ADC_SLEEP_TIME_MS);

		err = adc_read(adc, &sequence);
		if (err < 0) {
			LOG_ERR("Could not read (%d)", err);
			continue;
		}

		for (size_t channel_index = 0U; channel_index < CHANNEL_COUNT; channel_index++) {
			int32_t raw;
			int32_t val_mv;

			for (size_t sample_index = 0U; sample_index < CONFIG_SEQUENCE_SAMPLES;
			     sample_index++) {

				raw = channel_reading[sample_index][channel_index];
				val_mv = raw;

				err = adc_raw_to_millivolts(vrefs_mv[channel_index],
							    channel_cfgs[channel_index].gain,
							    CONFIG_SEQUENCE_RESOLUTION, &val_mv);

				/* conversion to mV may not be supported, skip if not */
				if ((err < 0) || vrefs_mv[channel_index] == 0) {
					printk("% 4" PRId32 ",", raw);
				} else {
					printk("% 4" PRId32 ",", val_mv);
				}
			}
			printk("\n");
		}
	}

	return 0;
}

K_THREAD_DEFINE(adc_id, STACKSIZE, handle_adc, NULL, NULL, NULL, PRIORITY, 0, 0);
```

## src/blink.c
```c
/**
 * blink.c
 *
 * Code came from https://github.com/Blen-E/pracblink, which
 * originally from zephyr/samples/basic/blinky.
 *
 * Modified slightly to run as a thread and use logging.
 */
#include <stdio.h>
#include <zephyr/kernel.h>
#include <zephyr/drivers/gpio.h>
#include <zephyr/sys/printk.h> 
#include <zephyr/sys/__assert.h>

#include <zephyr/device.h>
#include <zephyr/devicetree.h>
#include <zephyr/logging/log.h>

LOG_MODULE_REGISTER(oresat_blink_demo, LOG_LEVEL_DBG);

/* size of stack area used by each thread */
#define STACKSIZE 1024

/* scheduling priority used by each thread */
#define PRIORITY 7

/* 1000 msec = 1 sec */
#define LED_SLEEP_TIME_MS   1000

/* The devicetree node identifier for the "led0" alias. */
#define LED0_NODE DT_ALIAS(led0)

static int handle_blink(void)
{
	int ret;
	const struct gpio_dt_spec led = GPIO_DT_SPEC_GET(LED0_NODE, gpios);

	LOG_INF("Starting blink demo");

	/* Can we use the LED? */
	if (!device_is_ready(led.port)) {
		LOG_ERR("LED device is not ready");
		return -1;
	}

	/* Set it up */
	ret = gpio_pin_configure_dt(&led, GPIO_OUTPUT_ACTIVE);
	if (ret < 0) {
		LOG_ERR("Could not configure the LED GPIO pin: %d", ret);
		return ret;
	}

	/* Thread loop */
	while (1) {
		gpio_pin_toggle_dt(&led);
		LOG_DBG("The light is blinking!");
		k_msleep(LED_SLEEP_TIME_MS);
	}
	return 0;
}

K_THREAD_DEFINE(blink_id, STACKSIZE, handle_blink, NULL, NULL, NULL, PRIORITY, 0, 0);
```

## src/dac.c
```c
/**
 * dac.c
 *
 * Original code came from zephyr/samples/driver/dac.
 *
 * Modified slightly to run as a thread and use logging.
 */
#include <stdio.h>
#include <zephyr/kernel.h>
#include <zephyr/sys/printk.h> 
#include <zephyr/sys/__assert.h>

#include <zephyr/device.h>
#include <zephyr/devicetree.h>
#include <zephyr/drivers/sensor.h>
#include <zephyr/drivers/sensor_data_types.h>
#include <zephyr/rtio/rtio.h>
#include <zephyr/dsp/print_format.h>
#include <zephyr/drivers/dac.h>
#include <zephyr/drivers/adc.h>
#include <zephyr/logging/log.h>

LOG_MODULE_REGISTER(oresat_dac_demo, LOG_LEVEL_DBG);

/* size of stack area used by each thread */
#define STACKSIZE 1024

/* scheduling priority used by each thread */
#define PRIORITY_DAC 6

#define ZEPHYR_USER_NODE DT_PATH(zephyr_user)

#if (DT_NODE_HAS_PROP(ZEPHYR_USER_NODE, dac) && \
	DT_NODE_HAS_PROP(ZEPHYR_USER_NODE, dac_channel_id) && \
	DT_NODE_HAS_PROP(ZEPHYR_USER_NODE, dac_resolution))
#define DAC_NODE DT_PHANDLE(ZEPHYR_USER_NODE, dac)
#define DAC_CHANNEL_ID DT_PROP(ZEPHYR_USER_NODE, dac_channel_id)
#define DAC_RESOLUTION DT_PROP(ZEPHYR_USER_NODE, dac_resolution)
#else
#error "Unsupported board: see README and check /zephyr,user node"
#define DAC_NODE DT_INVALID_NODE
#define DAC_CHANNEL_ID 0
#define DAC_RESOLUTION 0
#endif

static int handle_dac(void)
{
	int ret;
	const struct device *const dac_dev = DEVICE_DT_GET(DAC_NODE);
	const struct dac_channel_cfg dac_ch_cfg = {
		.channel_id  = DAC_CHANNEL_ID,
		.resolution  = DAC_RESOLUTION,
	#if defined(CONFIG_DAC_BUFFER_NOT_SUPPORT)
		.buffered = false,
	#else
		.buffered = true,
	#endif /* CONFIG_DAC_BUFFER_NOT_SUPPORT */
	};

	LOG_INF("Starting DAC demo");

	/* Can we use the DAC? */
	if (!device_is_ready(dac_dev)) {
		LOG_ERR("DAC device %s is not ready", dac_dev->name);
		return -1;
	}

	/* Set it up */
	ret = dac_channel_setup(dac_dev, &dac_ch_cfg);
	if (ret != 0) {
		LOG_ERR("Setting up of DAC channel failed with code %d", ret);
		return ret;
	}

	/* Number of valid DAC values, e.g. 4096 for 12-bit DAC */
	const int dac_values = 1U << DAC_RESOLUTION;
	/*
	 * 100 usec sleep leads to about 0.4 sec signal period for 12-bit
	 * DACs. For DACs with lower resolution, sleep time needs to
	 * be increased.
	 */
	const int sleep_time = (4096 / dac_values > 0 ? 4096 / dac_values : 1) * 100;

	LOG_DBG("Generating sawtooth signal at DAC channel %d.", DAC_CHANNEL_ID);
	LOG_DBG("Number of DAC samples per cycle: %d, sleep time per sample (us): %d",
		   dac_values, sleep_time);
	int cycle = 0;

	while (1) {
		for (int i = 0; i < dac_values; i++) {
			ret = dac_write_value(dac_dev, DAC_CHANNEL_ID, i);
			if (ret != 0) {
				LOG_ERR("dac_write_value() failed with code %d", ret);
				return ret;
			}
			k_sleep(K_USEC(sleep_time));
		}
		LOG_INF("Cycle %u", ++cycle);
	}
	return 0;
}

K_THREAD_DEFINE(dac_id, STACKSIZE, handle_dac, NULL, NULL, NULL, PRIORITY_DAC, 0, 0);
```

## src/i2c_sensor.c
```c
/**
 * i2c_sensor.c
 *
 * Original code came from zephyr/samples/sensor/bme280.
 *
 * Modified slightly to run as a thread and use logging.
 */
#include <stdio.h>
#include <zephyr/kernel.h>
#include <zephyr/sys/printk.h> 
#include <zephyr/sys/__assert.h>

#include <zephyr/device.h>
#include <zephyr/devicetree.h>
#include <zephyr/drivers/sensor.h>
#include <zephyr/drivers/sensor_data_types.h>
#include <zephyr/rtio/rtio.h>
#include <zephyr/logging/log.h>

LOG_MODULE_REGISTER(oresat_i2c_sensor_demo, LOG_LEVEL_DBG);

/* size of stack area used by each thread */
#define STACKSIZE 1024

/* scheduling priority used by each thread */
#define PRIORITY 7

/* 1000 msec = 1 sec */
#define BME_SLEEP_TIME_MS   5000

static const struct device *check_bme280_device(const struct device *bme_dev)
{
	if (bme_dev == NULL) {
		/* No such node, or the node does not have status "okay". */
		LOG_ERR("\nError: no device found.");
		return NULL;
	}

	if (!device_is_ready(bme_dev)) {
		LOG_ERR("\nError: Device \"%s\" is not ready; "
		       "check the driver initialization logs for errors.",
		       bme_dev->name);
		return NULL;
	}

	LOG_INF("Found device \"%s\", getting sensor data", bme_dev->name);
	return bme_dev;
}

/*
 * Get a device structure from a devicetree node with compatible
 * "bosch,bme280". (If there are multiple, just pick one.)
 */
SENSOR_DT_READ_IODEV(iodev, DT_COMPAT_GET_ANY_STATUS_OKAY(bosch_bme280),
		{SENSOR_CHAN_AMBIENT_TEMP, 0},
		{SENSOR_CHAN_HUMIDITY, 0},
		{SENSOR_CHAN_PRESS, 0});

RTIO_DEFINE(ctx, 1, 1);

static int handle_bme280(void)
{
	int ret;
	uint8_t buf[128];
	const struct device *const bme_dev = DEVICE_DT_GET_ANY(bosch_bme280);

	LOG_INF("Starting I2C sensor demo");

	/* Can we use the I2C sensor? */
	if (check_bme280_device(bme_dev) == NULL) {
		LOG_ERR("Could not find the BME280");
		return -1;
	}

	/* Thread loop */
	while (1) {
		ret = sensor_read(&iodev, &ctx, buf, 128);
		if (ret != 0) {
			LOG_ERR("%s: sensor_read() failed: %d", bme_dev->name, ret);
			break;
		}

		const struct sensor_decoder_api *decoder;

		ret = sensor_get_decoder(bme_dev, &decoder);
		if (ret != 0) {
			LOG_ERR("%s: sensor_get_decode() failed: %d", bme_dev->name, ret);
			break;
		}

		uint32_t temp_fit = 0;
		struct sensor_q31_data temp_data = {0};

		decoder->decode(buf, (struct sensor_chan_spec) {SENSOR_CHAN_AMBIENT_TEMP, 0},
						&temp_fit, 1, &temp_data);

		uint32_t press_fit = 0;
		struct sensor_q31_data press_data = {0};

		decoder->decode(buf, (struct sensor_chan_spec) {SENSOR_CHAN_PRESS, 0},
						&press_fit, 1, &press_data);

		uint32_t hum_fit = 0;
		struct sensor_q31_data hum_data = {0};

		decoder->decode(buf, (struct sensor_chan_spec) {SENSOR_CHAN_HUMIDITY, 0},
						&hum_fit, 1, &hum_data);

		printk("temp: %s%d.%d; press: %s%d.%d; humidity: %s%d.%d\n",
			PRIq_arg(temp_data.readings[0].temperature, 6, temp_data.shift),
			PRIq_arg(press_data.readings[0].pressure, 6, press_data.shift),
			PRIq_arg(hum_data.readings[0].humidity, 6, hum_data.shift));

		k_msleep(BME_SLEEP_TIME_MS);
	}
	return ret;
}

K_THREAD_DEFINE(bme280_id, STACKSIZE, handle_bme280, NULL, NULL, NULL, PRIORITY, 0, 0);
```
